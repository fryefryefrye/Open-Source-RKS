#ifndef __Day_H__ 
#define __Day_H__ 
/*---------------------------------公历转换阴历年份数据表--------------------------------*/

const unsigned char year_code[]PROGMEM={
  0x04,0xAe,0x53, //1901 0
  0x0A,0x57,0x48, //1902 3
  0x55,0x26,0xBd, //1903 6
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  0x2d,0x92,0xB5, //2099
};

/*-------------------------------------月份数据表----------------------------------------*/

const unsigned char day_code1[9]PROGMEM={0x0,0x1f,0x3b,0x5a,0x78,0x97,0xb5,0xd4,0xf3};
const unsigned int day_code2[3]PROGMEM={0x111,0x130,0x14e};

unsigned char year_moon,month_moon,day_moon;//农历年，月，日
unsigned char jieqi_day,jieqi_dat;//节气日期，节气编号
bool run_yue;//闰月标志

/*子函数,用于读取数据表中农历月的大月或小月,如果该月为大返回1,为小返回0------------------*/
static unsigned char GetMoonDay(byte month_p,int table_addr)
{
  switch (month_p)
  {
    case 1:
      if((year_code[table_addr]&0x08)==0)
        return(0);
      else
        return(1); 
    case 2:
      if((year_code[table_addr]&0x04)==0)
        return(0);
      else                   
        return(1);
    case 3:
      if((year_code[table_addr]&0x02)==0)   
        return(0);
      else                  
        return(1);
    case 4:
      if((year_code[table_addr]&0x01)==0)   
        return(0);
      else                    
        return(1);
    case 5:
      if((year_code[table_addr+1]&0x80)==0) 
        return(0);
      else                  
        return(1);
    case 6:
      if((year_code[table_addr+1]&0x40)==0) 
        return(0);
      else                  
        return(1);
    case 7:
      if((year_code[table_addr+1]&0x20)==0) 
        return(0);
      else                  
        return(1);
    case 8:
      if((year_code[table_addr+1]&0x10)==0) 
        return(0);
      else                  
        return(1);
    case 9:
      if((year_code[table_addr+1]&0x08)==0) 
        return(0);
      else                  
        return(1);
    case 10:
      if((year_code[table_addr+1]&0x04)==0) 
        return(0);
      else                  
        return(1);
    case 11:
      if((year_code[table_addr+1]&0x02)==0) 
        return(0);
      else                  
        return(1);
    case 12:
      if((year_code[table_addr+1]&0x01)==0) 
        return(0);
      else                  
        return(1);
    case 13:
      if((year_code[table_addr+2]&0x80)==0) 
        return(0);
      else                  
        return(1);
  }
  return(0);
}
/*--------------------------------公历转农历函数-----------------------------------------*/

void Conversion(bool c,unsigned char yy,unsigned char mm,unsigned char dd)//0 年月日
{   //c=0 为21世纪,c=1 为19世纪 输入输出数据均为BCD数据                      
  unsigned char temp1,temp2,temp3,month_p;
  unsigned int temp4,table_addr;
  bool flag2,flag_y;
  //定位数据表地址
  if(c==0)
    table_addr=(yy+0x64-1)*0x3;  //0x64 = 100
  else 
    table_addr=(yy-1)*0x3;
  //取当年春节所在的公历月份
  temp1=year_code[table_addr+2]&0x60;       //
  temp1=(temp1<<(8-5))|(temp1>>5);
  temp2=year_code[table_addr+2]&0x1f;  //0x1f = 31
  //取当年春节所在的公历日完成 
  //计算当年春年离当年元旦的天数,春节只会在公历1月或2月 
  if(temp1==0x1)
    temp3=temp2-1;  
  else
    temp3=temp2+0x1f-1;
  // 计算当年春年离当年元旦的天数完成 
  //计算公历日离当年元旦的天数,为了减少运算,用了两个表 
  //day_code1[9],day_code2[3] 
  //如果公历月在九月或前,天数会少于0xff,用表day_code1[9], 
  //在九月后,天数大于0xff,用表day_code2[3] 
  //如输入公历日为8月10日,则公历日离元旦天数为day_code1[8-1]+10-1 
  //如输入公历日为11月10日,则公历日离元旦天数为day_code2[11-10]+10-1 
  if(mm<10)
    temp4=day_code1[mm-1]+dd-1;
  else
    temp4=day_code2[mm-10]+dd-1;
  
  //  if ((month>0x2)&&(year%0x4==0)&&(year!=0)) //此语句造成2000年3月1日—12月31日之间
  //计算农历少算一天，应删除判断语句“&&(year!=0)”
  if((mm>0x2)&&(yy%0x4==0))
    temp4+=1; //如果公历月大于2月并且该年的2月为闰月,天数加1
  //计算公历日离当年元旦的天数完成 
  
  //判断公历日在春节前还是春节后
  if(temp4>=temp3)
  { 
    temp4-=temp3;
    mm=0x1;
    month_p=0x1;  //month_p为月份指向,公历日在春节前或就是春节当日month_p指向首月
    flag2=GetMoonDay(month_p,table_addr); //检查该农历月为大小还是小月,大月返回1,小月返回0
    flag_y=0;
    if(flag2==0)
      temp1=0x1d;   //小月29天
    else
      temp1=0x1e;    //大月30天
    temp2=year_code[table_addr]&0xf0;
    temp2=(temp2<<(8-4))|(temp2>>4);//从数据表中取该年的闰月月份,如为0则该年无闰月
    while(temp4>=temp1)
    {
      temp4-=temp1;
      month_p+=1;
      if(mm==temp2)
      {
        flag_y=~flag_y;
        if(flag_y==0)
          mm+=1;
      }
      else
        mm+=1;
      flag2=GetMoonDay(month_p,table_addr);
      if(flag2==0)
        temp1=0x1d;
      else
        temp1=0x1e;
    }
    dd=temp4+1;
  }
  else
  {  
    temp3-=temp4;
    if(yy==0x0)
    {
      yy=0x63;
      c=1;
    }
    else
      yy-=1;
    table_addr-=0x3;
    mm=0xc;
    temp2=year_code[table_addr]&0xf0;
    temp2=(temp2<<(8-4))|(temp2>>4);
    if(temp2==0)
      month_p=0xc; 
    else
      month_p=0xd; 
    flag_y=0;
    flag2=GetMoonDay(month_p,table_addr);
    if(flag2==0)
      temp1=0x1d;
    else
      temp1=0x1e;
    while(temp3>temp1)
    {
      temp3-=temp1;
      month_p-=1;
      if(flag_y==0)
        mm-=1;
      if(mm==temp2)
        flag_y=~flag_y;
      flag2=GetMoonDay(month_p,table_addr);
      if(flag2==0)
        temp1=0x1d;
      else
        temp1=0x1e;
    }
    dd=temp1-temp3+1;
  }
  if(month_p-temp2==1)//是闰月
    run_yue=1;
  else//没有闰月
    run_yue=0;
  year_moon=yy;  //农历年
  month_moon=mm;      //农历月
  day_moon=dd;        //农历日
}
/*****************************************************************************************************
函数功能： 二十四节气数据库
入口参数： void (yy,mo,dd) 对应 年月日
二十四节气数据库（1901--2050） 
数据格式说明:   
如1901年的节气为   
     1月    2月     3月     4月       5月      6月    7月     8月      9月    10月   11月    12月   
[ 6,21][ 4,19][ 6,21][ 5,21][ 6,22][ 6,22][ 8,23][ 8,24][ 8,24][ 8,24][ 8,23][ 8,22]   
[ 9, 6][11, 4][ 9, 6][10, 6][ 9, 7][ 9, 7][ 7, 8][ 7, 9][ 7, 9][ 7, 9][ 7, 8][ 7,15]   
上面第一行数据为每月节气对应公历日期,15减去每月第一个节气,每月第二个节气减去15得第二
行，这样每月两个节气对应数据都小于16,每月用一个字节存放,高位存放第一个节气数据,低位存
放第二个节气的数据,可得下表   
******************************************************************************************************/
const unsigned char jieqi_code[]PROGMEM=
{
  0x96,0xB4,0x96,0xA6,0x97,0x97,0x78,0x79,0x79,0x69,0x78,0x77,     //1901   
  0x96,0xA4,0x96,0x96,0x97,0x87,0x79,0x79,0x79,0x69,0x78,0x78,     //1902   
  0x96,0xA5,0x87,0x96,0x87,0x87,0x79,0x69,0x69,0x69,0x78,0x78,     //1903   
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  0xA5,0xC3,0xA5,0xB5,0xA6,0xA6,0x87,0x88,0x78,0x78,0x87,0x87,     //2050
};

const unsigned char yue_r[]PROGMEM={31,29,31,30,31,30,31,31,30,31,30,31};//闰年每月天数
const unsigned char yue_p[]PROGMEM={31,28,31,30,31,30,31,31,30,31,30,31};//平年每月天数

void read_jieqi(unsigned char y1,unsigned char m,unsigned char d)//年月日
{
  unsigned char temp;
  unsigned int addr,y;
  bool flag_run=0;
  
  y=y1+2000;
  if((y%4==0&&y%100!=0)||y%400==0)
    flag_run=1;//是闰年
    
  y=y-1901;
  addr=y*12+m-1;
  
  temp=jieqi_code[addr]>>4;//取出当月第一个节气
  temp=15-temp;//换算成日期
  if(d<=temp)//第一个节气
  {
    jieqi_day=temp;//取出节气日期
    jieqi_dat=m*2-1;//节气编号
  }
  else//第二个节气
  {
    temp=jieqi_code[addr]&0x0f;//取出当月第二个节气
    temp=temp+15;//换算成日期
    jieqi_day=temp;//取出节气日期
    jieqi_dat=m*2;//取出节气编号
  }
  if(d>jieqi_day)//超过第二个节气
  {
    m++;
    if(m>12)
      m=1;
    addr++;
    temp=jieqi_code[addr]>>4;//取出当月第一个节气
    temp=15-temp;//换算成日期
    jieqi_day=temp;//取出节气日期
    jieqi_dat=m*2-1;//节气编号

    if(flag_run==1)
      jieqi_day=yue_r[m-2]-d+jieqi_day;
    else
      jieqi_day=yue_p[m-2]-d+jieqi_day;
  }
  else
    jieqi_day=jieqi_day-d;
}
#endif

